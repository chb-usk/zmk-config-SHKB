## Kconfig
```kconfig
config SHKB_LAYER_LED
    bool "Drive the XIAO BLE onboard RGB LED as a layer/battery/BLE profile indicator"
    select GPIO

config SHKB_LAYER_LED_SHOW_LAYERS
    bool "Light the LED in a per-layer color on layer changes sent by the central"
    default y
    depends on SHKB_LAYER_LED

config SHKB_LAYER_LED_DURATION_MS
    int "How long the layer color stays lit after a layer change (ms)"
    default 1000
    depends on SHKB_LAYER_LED_SHOW_LAYERS

config SHKB_LAYER_LED_BATTERY
    bool "Show the battery level on the LED at power-on (green/yellow/red)"
    default y
    depends on SHKB_LAYER_LED && ZMK_BATTERY_REPORTING

config SHKB_LAYER_LED_BATTERY_MS
    int "How long the power-on battery color stays lit (ms)"
    default 2000
    depends on SHKB_LAYER_LED_BATTERY

config SHKB_LAYER_LED_PROFILE
    bool "Blink the active BLE profile's color at power-on and on profile switch"
    depends on SHKB_LAYER_LED && ZMK_BLE && (!ZMK_SPLIT || ZMK_SPLIT_ROLE_CENTRAL)

config SHKB_LAYER_LED_PROFILE_MS
    int "Total duration of the BLE profile blink (ms)"
    default 2000
    depends on SHKB_LAYER_LED_PROFILE

config SHKB_LAYER_LED_PROFILE_BLINK_MS
    int "On time and off time of each BLE profile blink (ms)"
    default 200
    depends on SHKB_LAYER_LED_PROFILE

config SHKB_LAYER_LED_NOTIFY
    bool "Send layer changes to the layer LED on every split half via the lyr_led behavior"
    depends on !ZMK_SPLIT || ZMK_SPLIT_ROLE_CENTRAL

config SHKB_PROFILE_BASE_LAYER
    bool "Switch to the active BLE profile's base layer at power-on and on profile change"
    depends on ZMK_BLE && SETTINGS && (!ZMK_SPLIT || ZMK_SPLIT_ROLE_CENTRAL)

if SHKB_PROFILE_BASE_LAYER

config SHKB_PROFILE_BASE_LAYER_0
    int "Base layer for BLE profile 0"
    default 0

config SHKB_PROFILE_BASE_LAYER_1
    int "Base layer for BLE profile 1"
    default 0

config SHKB_PROFILE_BASE_LAYER_2
    int "Base layer for BLE profile 2"
    default 1

config SHKB_PROFILE_BASE_LAYER_3
    int "Base layer for BLE profile 3"
    default 1

config SHKB_PROFILE_BASE_LAYER_4
    int "Base layer for BLE profile 4"
    default 2

endif

DT_COMPAT_ZMK_BEHAVIOR_SHKB_LAYER_LED := zmk,behavior-shkb-layer-led

config ZMK_BEHAVIOR_SHKB_LAYER_LED
    bool
    default $(dt_compat_enabled,$(DT_COMPAT_ZMK_BEHAVIOR_SHKB_LAYER_LED))
```

## config/boards/shields/shkb/Kconfig.shield
```kconfig
config SHIELD_SHKB_L
	def_bool $(shields_list_contains,shkb_l)

config SHIELD_SHKB_R
	def_bool $(shields_list_contains,shkb_r)

# Dongle-mode shields
config SHIELD_SHKB_L_PERIPHERAL
	def_bool $(shields_list_contains,shkb_l_peripheral)

config SHIELD_SHKB_R_PERIPHERAL
	def_bool $(shields_list_contains,shkb_r_peripheral)

config SHIELD_SHKB_DONGLE
	def_bool $(shields_list_contains,shkb_dongle)
```

## config/west.yml
```yaml
manifest:
  remotes:
    - name: zmkfirmware
      url-base: https://github.com/zmkfirmware
    - name: sayu-hub
      url-base: https://github.com/sayu-hub
    - name: badjeff       # PMW3610 trackball driver
      url-base: https://github.com/badjeff
    - name: caksoylar     # RGB LED widget
      url-base: https://github.com/caksoylar
    - name: carrefinho    # Prospector dongle display module
      url-base: https://github.com/carrefinho
  projects:
    - name: zmk
      remote: zmkfirmware
      revision: v0.3
      import: app/west.yml
    - name: zmk-pmw3610-driver
      remote: badjeff
      revision: main
    - name: zmk-rgbled-widget
      remote: caksoylar
      revision: main
    - name: prospector-zmk-module
      remote: carrefinho
      revision: main
  self:
    path: config
```

## dts/bindings/behaviors/zmk,behavior-shkb-layer-led.yaml
```yaml
description: Show a layer's color on the local layer LED (param = layer index)

compatible: "zmk,behavior-shkb-layer-led"

include: one_param.yaml
```
